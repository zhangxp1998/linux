## arch/arm64/Kconfig.debug
```kconfig
# SPDX-License-Identifier: GPL-2.0-only

config PID_IN_CONTEXTIDR
	bool "Write the current PID to the CONTEXTIDR register"
	help
	  Enabling this option causes the kernel to write the current PID to
	  the CONTEXTIDR register, at the expense of some additional
	  instructions during context switch. Say Y here only if you are
	  planning to use hardware trace tools with this kernel.

config DEBUG_EFI
	depends on EFI && DEBUG_INFO
	bool "UEFI debugging"
	help
	  Enable this option to include EFI specific debugging features into
	  the kernel that are only useful when using a debug build of the
	  UEFI firmware

config ARM64_RELOC_TEST
	depends on m
	tristate "Relocation testing module"

config ARM64_PTE_KUNIT_TEST
	tristate "KUnit tests for arm64 PTE helpers" if !KUNIT_ALL_TESTS
	depends on KUNIT
	default KUNIT_ALL_TESTS
	help
	  Build unit tests for arm64 PTE helpers, including physical-address
	  advancement across native pages and, when configured, PPPS slices.

	  For more information on KUnit and unit tests in general, refer to
	  Documentation/dev-tools/kunit/.

	  If unsure, say N.

source "drivers/hwtracing/coresight/Kconfig"
```
